	AREA RESET, DATA, READONLY
	EXPORT __Vectors
__Vectors 
	DCD 0x10001000 ; stack pointer value when stack is empty
	DCD Reset_Handler ; reset vector
	ALIGN
	AREA mycode, CODE, READONLY
	ENTRY
	EXPORT Reset_Handler
Reset_Handler
	LDR R6,=DST
	LDR R3,=SRC1
	LDR R4,=SRC2
	MOV R8,#0X20000000
	MSR xPSR ,R8
	MOV R5,#4
BACK LDR R0,[R3],#4
	LDR R1,[R4],#4
	SBCS R2,R0,R1
	STR R2,[R6],#4
	SUB R5,#1
	TEQ R5,#0
	BNE BACK
	ADC R7,#0
	STR R7,[R6]
STOP B STOP
SRC1 DCD 0XFC457A36, 0X41FFA563, 0XB5A2334C , 0X45AECF12
SRC2 DCD 0X56AD34EB, 0XEF88AC12, 0X67559A48, 0XFFFEF231
	AREA mydata,DATA,READWRITE
DST DCD 0,0,0,0,0
	END